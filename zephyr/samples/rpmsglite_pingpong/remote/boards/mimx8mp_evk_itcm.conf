## zephyr/samples/rpmsglite_pingpong/remote/boards/mimx8mp_evk_itcm.conf
```kconfig
CONFIG_STDOUT_CONSOLE=n
CONFIG_PRINTK=y
CONFIG_IPM=y
CONFIG_IPM_IMX=y
CONFIG_IPM_IMX_MAX_DATA_SIZE_4=y
CONFIG_MBOX_NXP_IMX_MU=y
CONFIG_RPMSGLITE=y
CONFIG_RPMSGLITE_QUEUE=y
CONFIG_RPMSGLITE_QUEUE=y
CONFIG_RPMSGLITE_NS=y
```
